## config/boards/shields/blackvelvet/Kconfig.shield
```kconfig
config SHIELD_STAGGERSAURUS_LEFT
    def_bool $(shields_list_contains,staggersaurus_left)

config SHIELD_STAGGERSAURUS_RIGHT
    def_bool $(shields_list_contains,staggersaurus_right)
```

## config/boards/shields/staggersaurus/Kconfig.defconfig
```kconfig
if SHIELD_STAGGERSAURUS

config ZMK_KEYBOARD_NAME
    default "Staggersaurus"

endif
```
